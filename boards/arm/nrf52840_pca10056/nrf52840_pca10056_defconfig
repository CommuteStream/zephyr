## boards/arm/nrf52840_pca10056/nrf52840_pca10056_defconfig
```kconfig
CONFIG_ARM=y
CONFIG_SOC_FAMILY_NRF=y
CONFIG_SOC_SERIES_NRF52X=y
CONFIG_SOC_NRF52840_QIAA=y
CONFIG_BOARD_NRF52840_PCA10056=y

# Enable MPU
CONFIG_ARM_MPU=y

# enable uart driver
CONFIG_SERIAL=n
CONFIG_UART_NRFX=n
CONFIG_UART_0_NRF_UART=n

# enable console
CONFIG_CONSOLE=n
CONFIG_UART_CONSOLE=n

# additional board options
CONFIG_GPIO_AS_PINRESET=y

# bluetooth
CONFIG_BT=y
CONFIG_BT_CTLR=y
```

## drivers/sensor/lis3mdl/Kconfig
```kconfig
# Copyright (c) 2016 Intel Corporation
#
# SPDX-License-Identifier: Apache-2.0
#

menuconfig LIS3MDL
	bool "LIS3MDL magnetometer"
	depends on SENSOR && (I2C || SPI)
	help
	  Enable driver for LIS3MDL I2C-based magnetometer.

choice LIS3MDL_BUS_TYPE
	prompt "Interface to AP"
	depends on LIS3MDL
	help
	  Select interface the LIS3MDL driver is connected to AP

config LIS3MDL_I2C
	depends on I2C
	bool "I2C Interface"

config LIS3MDL_SPI
	depends on SPI
	bool "SPI Interface"

endchoice

config LIS3MDL_DEV_NAME
	string "LIS3MDL device name"
	depends on (LIS3MDL_I2C && !HAS_DTS_I2C_DEVICE) || LIS3MDL_SPI
	default "LIS3MDL"

if !HAS_DTS_I2C_DEVICE

config LIS3MDL_I2C_ADDR
	hex "I2C address"
	depends on LIS3MDL
	default 0x1E
	help
	  I2C address of the LIS3MDL sensor.
	  Use 0x1C if the SA1 pin is pulled to GND or 0x1E if the SA1 pin
	  is pulled to VDD.

config LIS3MDL_I2C_MASTER_DEV_NAME
	string "I2C master where LIS3MDL is connected"
	depends on LIS3MDL
	default "I2C_0"
	help
	  Specify the device name of the I2C master device to which LIS3MDL is
	  connected.

config LIS3MDL_I2C_GPIO_CS
	bool "LIS3MDL CS I2C enable set through a GPIO pin"
	depends on LIS3MDL && LIS3MDL_I2C
	help
	  This option is useful if one needs to manage CS through a GPIO
	  which must be set high for I2C operations.

config LIS3MDL_I2C_GPIO_SA1
	bool "LIS3MDL I2C SA1 through a GPIO pin"
	depends on LIS3MDL && LIS3MDL_I2C
	help
	  This option is useful if one needs to manage SA1 through a GPIO
	  which may be adjusted to set the I2C address.

config LIS3MDL_I2C_GPIO_CS_DRV_NAME
	string "GPIO driver's name to use to drive CS through"
	default ""
	depends on LIS3MDL_I2C_GPIO_CS
	help
	  This option is mandatory to set which GPIO controller to use in order
	  to actually set CS.

config LIS3MDL_I2C_GPIO_CS_PIN
	int "GPIO PIN to use to drive CS through"
	default 0
	depends on LIS3MDL_I2C_GPIO_CS
	help
	  This option is mandatory to set which GPIO pin to use in order
	  to actually set CS.

config LIS3MDL_I2C_GPIO_SA1_DRV_NAME
	string "GPIO driver's name to use to drive SA1 through"
	default ""
	depends on LIS3MDL_I2C_GPIO_SA1
	help
	  This option is mandatory to set which GPIO controller to use in order
	  to actually set SA1 which is used to adjust the I2C address.

config LIS3MDL_I2C_GPIO_SA1_PIN
	int "GPIO PIN to use to drive CS through"
	default 0
	depends on LIS3MDL_I2C_GPIO_SA1
	help
	  This option is mandatory to set which GPIO pin to use in order
	  to actually set CS.

endif #HAS_DTS_I2C_DEVICE

if !HAS_DTS_SPI_DEVICE

config LIS3MDL_SPI_SELECT_SLAVE
	hex "LIS3MDL SPI slave select pin"
	depends on LIS3MDL && LIS3MDL_SPI
	default 1
	help
	  LIS3MDL SPI chip select pin (active low).

config LIS3MDL_SPI_BUS_FREQ
	int "LIS3MDL SPI bus speed in Hz"
	default 8000000
	depends on LIS3MDL && LIS3MDL_SPI
	help
	  This is the maximum supported SPI bus frequency. The chip supports a
	  frequency up to 10MHz.

config LIS3MDL_SPI_MASTER_DEV_NAME
	string "SPI master name where LIS3MDL chip is connected"
	depends on LIS3MDL && LIS3MDL_SPI
	default "SPI_2"
	help
	  Specify the device name of the spi master device to which LIS3MDL is
	  connected.

endif #HAS_DTS_SPI_DEVICE

config LIS3MDL_SPI_GPIO_CS
	bool "LIS3MDL SPI CS through a GPIO pin"
	depends on LIS3MDL && LIS3MDL_SPI
	help
	  This option is useful if one needs to manage SPI CS through a GPIO
	  pin to by-pass the SPI controller's CS logic.

if !HAS_DTS_SPI_PINS

config LIS3MDL_SPI_GPIO_CS_DRV_NAME
	string "GPIO driver's name to use to drive SPI CS through"
	default ""
	depends on LIS3MDL_SPI_GPIO_CS
	help
	  This option is mandatory to set which GPIO controller to use in order
	  to actually emulate the SPI CS.

config LIS3MDL_SPI_GPIO_CS_PIN
	int "GPIO PIN to use to drive SPI CS through"
	default 0
	depends on LIS3MDL_SPI_GPIO_CS
	help
	  This option is mandatory to set which GPIO pin to use in order
	  to actually emulate the SPI CS.

endif # !HAS_DTS_SPI_PINS


choice LIS3MDL_TRIGGER_MODE
	prompt "Trigger mode"
	depends on LIS3MDL
	default LIS3MDL_TRIGGER_GLOBAL_THREAD
	help
	  Specify the type of triggering to be used by the driver.

config LIS3MDL_TRIGGER_NONE
	bool "No trigger"

config LIS3MDL_TRIGGER_GLOBAL_THREAD
	bool "Use global thread"
	depends on GPIO
	select LIS3MDL_TRIGGER

config LIS3MDL_TRIGGER_OWN_THREAD
	bool "Use own thread"
	depends on GPIO
	select LIS3MDL_TRIGGER

config LIS3MDL_TRIGGER_IRQ
	bool "Trigger callback is run in the interrupt callback"
	depends on GPIO
	select LIS3MDL_TRIGGER

endchoice # LIS3MDL_TRIGGER_MODE

config LIS3MDL_TRIGGER
	bool
	depends on LIS3MDL

config LIS3MDL_GPIO_DEV_NAME
	string "GPIO device"
	default "GPIO_0"
	depends on LIS3MDL
	help
	  The device name of the GPIO device to which the LIS3MDL interrupt pins
	  are connected.

config LIS3MDL_GPIO_DRDY_PIN_NUM
	int "Dataready GPIO pin number"
	default 0
	depends on LIS3MDL && LIS3MDL_TRIGGER
	help
	  The number of the GPIO on which the interrupt signal from the LIS3MDL
	  chip will be received.

config LIS3MDL_GPIO_SA1_PIN_NUM
	int "I2C Address pin if I2C is used, optionally set the address pin high/low to adjust the address"
	default 0
	depends on LIS3MDL
	help
	  The number of the GPIO on which the SA1 signal to the LIS3MDL
	  chip will be sent.

config LIS3MDL_THREAD_PRIORITY
	int "Thread priority"
	depends on LIS3MDL && LIS3MDL_TRIGGER_OWN_THREAD
	default 10
	help
	  Priority of thread used by the driver to handle interrupts.

config LIS3MDL_THREAD_STACK_SIZE
	int "Thread stack size"
	depends on LIS3MDL && LIS3MDL_TRIGGER_OWN_THREAD
	default 1024
	help
	  Stack size of thread used by the driver to handle interrupts.

config LIS3MDL_ODR
	string "Output data rate"
	depends on LIS3MDL
	default "0.625"
	help
	  Magnetometer output data rate expressed in samples per second.
	  Data rates supported by the chip are 0.625, 1.25, 2.5, 5, 10, 20,
	  40, 80, 155, 300, 560 and 1000.

config LIS3MDL_FS
	int "Full-scale range"
	depends on LIS3MDL
	default 4
	help
	  Magnetometer full-scale range.
	  An X value for the config represents a range of +/- X gauss. Valid
	  values are 4, 8, 12 and 16.
```
